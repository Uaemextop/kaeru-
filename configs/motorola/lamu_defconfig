## configs/motorola/lamu_defconfig
```kconfig
CONFIG_APP_ADDRESS=0x4C42A0C0
CONFIG_APP_CALLER=0x4C427950
CONFIG_BOOTLOADER_BASE=0x4C400000
CONFIG_BOOTLOADER_SIZE=0x157934
CONFIG_BOOTMODE_ADDRESS=0x4C5737EC
CONFIG_DPRINTF_ADDRESS=0x4C443CCC
CONFIG_ENVIRONMENT_SUPPORT=y
CONFIG_ENV_DATA_ADDR=0x4C5F39D0
CONFIG_FASTBOOT_FAIL_ADDRESS=0x4C42ABAC
CONFIG_FASTBOOT_INFO_ADDRESS=0x4C42AB2C
CONFIG_FASTBOOT_OKAY_ADDRESS=0x4C42AD78
CONFIG_FASTBOOT_PUBLISH_ADDRESS=0x4C42A6D8
CONFIG_FASTBOOT_REGISTER_ADDRESS=0x4C42A69C
CONFIG_FRAMEBUFFER_ADDRESS=0x76F20000
CONFIG_FRAMEBUFFER_ALIGNMENT=64
CONFIG_FRAMEBUFFER_BPP=32
CONFIG_FRAMEBUFFER_HEIGHT=2400
CONFIG_FRAMEBUFFER_SUPPORT=y
CONFIG_FRAMEBUFFER_WIDTH=1080
CONFIG_FREE_ADDRESS=0x4C4440FC
CONFIG_GET_ENV_ADDRESS=0x4C460284
CONFIG_INIT_STORAGE_ADDRESS=0x4C403754
CONFIG_INIT_STORAGE_CALLER=0x4C403972
CONFIG_LEGACY_LK=n
CONFIG_LK_LOG_STORE_ADDRESS=0x4C459358
CONFIG_MALLOC_ADDRESS=0x4C444A08
CONFIG_MEDIATEK_MT6768=y
CONFIG_MOTOROLA_LAMU=y
CONFIG_MTK_DETECT_KEY_ADDRESS=0x4C4054F8
CONFIG_PARTITION_GET_SIZE_BY_NAME_ADDRESS=0x4C45FF60
CONFIG_PARTITION_READ_ADDRESS=0x4C461100
CONFIG_PLATFORM_INIT_ADDRESS=0x4C403944
CONFIG_PLATFORM_INIT_CALLER=0x4C4262AC
CONFIG_SET_ENV_ADDRESS=0x4C46049C
CONFIG_SPOOF_SUPPORT=y
CONFIG_STAGE1_SUPPORT=y
CONFIG_THREAD_CREATE_ADDRESS=0x4C426A68
CONFIG_THREAD_RESUME_ADDRESS=0x4C426C7C
CONFIG_VIDEO_PRINTF_ADDRESS=0x4C443698
```
